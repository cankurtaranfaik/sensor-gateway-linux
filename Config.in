## Config.in
```kconfig
source "$BR2_EXTERNAL_SENSGW_PATH/package/vimu/Config.in"
source "$BR2_EXTERNAL_SENSGW_PATH/package/telemd/Config.in"
```

## package/telemd/Config.in
```kconfig
config BR2_PACKAGE_TELEMD
	bool "telemd"
	help
	  Reads samples from /dev/vimu and streams them as UDP
	  telemetry frames. Started at boot by /etc/init.d/S90telemd.
```

## package/vimu/Config.in
```kconfig
config BR2_PACKAGE_VIMU
	bool "vimu"
	depends on BR2_LINUX_KERNEL
	help
	  Virtual IMU platform driver. Binds to a "sensgw,vimu" device
	  tree node and exposes synthetic IMU samples on /dev/vimu.

comment "vimu needs a Linux kernel to be built"
	depends on !BR2_LINUX_KERNEL
```
